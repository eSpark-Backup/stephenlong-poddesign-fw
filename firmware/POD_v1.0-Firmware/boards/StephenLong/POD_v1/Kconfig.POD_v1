## firmware/POD_v1.0-Firmware/drivers/Kconfig
```kconfig
# Copyright (c) 2021 Nordic Semiconductor ASA
# SPDX-License-Identifier: Apache-2.0

menu "Drivers"
# rsource "max17048_POD/Kconfig"
rsource "sensors/Kconfig"
endmenu
```

## firmware/POD_v1.0-Firmware/drivers/dts/bindings/spi/adi,ade9000.yaml
```yaml
description: ADE9000 Power Meter

compatible: "adi,ade9000"

include: ["spi-device.yaml"]

properties:
  reg:
    required: true

  spi-max-frequency:
    required: true

  cs-gpios:
    type: phandle-array
    required: true
    description: Chip select GPIO pin
```

## firmware/POD_v1.0-Firmware/drivers/sensors/Kconfig
```kconfig
# Copyright (c) 2021 Nordic Semiconductor ASA
# SPDX-License-Identifier: Apache-2.0

if SENSOR
rsource "max17048_POD/Kconfig"
endif # SENSOR
```

## firmware/POD_v1.0-Firmware/drivers/sensors/max17048_POD/Kconfig
```kconfig
# SPDX-License-Identifier: Apache-2.0

config MAX17048_POD
    bool "MAX17048_POD Li-Po fuel gauge"
    default y
    depends on DT_HAS_MAXIM_MAX17048_POD_ENABLED
    select I2C
    help
      Enable support for the MAX17048_POD fuel gauge device with ALRT interrupt.
```
